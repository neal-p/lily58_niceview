## config/west.yml
```yaml
manifest:
  remotes:
    - name: zmkfirmware
      url-base: https://github.com/zmkfirmware
  projects:
    - name: zmk
      remote: zmkfirmware
      revision: main
      import: app/west.yml
    - name: nice-view-gem #new entry: https://github.com/M165437/nice-view-gem
      remote: m165437 #new entry: https://github.com/M165437/nice-view-gem
      revision: main #new entry: https://github.com/M165437/nice-view-gem
  self:
    path: config
```
